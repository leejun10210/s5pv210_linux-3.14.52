## arch/arm/configs/s5pv210_defconfig
```kconfig
CONFIG_EXPERIMENTAL=y
CONFIG_SYSFS_DEPRECATED_V2=y
CONFIG_BLK_DEV_INITRD=y
CONFIG_KALLSYMS_ALL=y
CONFIG_MODULES=y
CONFIG_MODULE_UNLOAD=y
# CONFIG_BLK_DEV_BSG is not set
CONFIG_ARCH_S5PV210=y
CONFIG_S3C_LOWLEVEL_UART_PORT=1
CONFIG_FB_S3C_LTE480WV=y
CONFIG_S3C_DEV_FB=y
CONFIG_S5PV210_SETUP_FB_24BPP=y
# CONFIG_MACH_AQUILA is not set
# CONFIG_MACH_GONI is not set
# CONFIG_MACH_SMDKC110 is not set
CONFIG_MACH_SMDKV210=y
CONFIG_NO_HZ=y
CONFIG_HIGH_RES_TIMERS=y
CONFIG_VMSPLIT_2G=y
CONFIG_PREEMPT=y
CONFIG_AEABI=y
CONFIG_CMDLINE="root=/dev/ram0 rw ramdisk=8192 initrd=0x20800000,8M console=ttySAC1,115200 init=/linuxrc"
CONFIG_VFP=y
CONFIG_NEON=y
CONFIG_UEVENT_HELPER_PATH="/sbin/hotplug"

CONFIG_CGROUPS=y

CONFIG_BLK_DEV_LOOP=y
CONFIG_BLK_DEV_RAM=y
CONFIG_BLK_DEV_RAM_SIZE=8192
# CONFIG_MISC_DEVICES is not set
CONFIG_SCSI=y
CONFIG_BLK_DEV_SD=y
CONFIG_CHR_DEV_SG=y
CONFIG_INPUT_EVDEV=y
# CONFIG_INPUT_KEYBOARD is not set
# CONFIG_INPUT_MOUSE is not set
CONFIG_INPUT_TOUCHSCREEN=y
CONFIG_SERIAL_8250=y
CONFIG_SERIAL_SAMSUNG=y
CONFIG_SERIAL_SAMSUNG_CONSOLE=y

#
#i2c support
#
CONFIG_I2C=y
CONFIG_I2C_S3C2410=y
#
#touchscreens
#
# CONFIG_TOUCHSCREEN_GSLX680 is not set
CONFIG_TOUCHSCREEN_GSLX680=y
#
#net work support
#
CONFIG_NET=y

#
#Networking options
#
CONFIG_INET=y
CONFIG_IP_PNP=y
CONFIG_IP_PNP_DHCP=y
CONFIG_IP_PNP_BOOTP=y
CONFIG_PACKET=y
CONFIG_UNIX=y
CONFIG_IP_MULTICAST=y
#
#Network device support 
#
CONFIG_NETDEVICES=y
CONFIG_DM9000=y



#
# mmc driver
#
CONFIG_MMC=y
# CONFIG_MMC_DEBUG  is not set
CONFIG_MMC_SDHCI=y
CONFIG_MMC_SDHCI_S3C=y

#
#Input device support
#
CONFIG_INPUT_MISC=y
# CONFIG_INPUT_KXTJ9 is not set
# CONFIG_INPUT_KXTJ9_POLLED_MODE is not set

#
#touchscreen
#
# CONFIG_TOUCHSCREEN_EDT_FT5X06 is not set


CONFIG_HW_RANDOM=y
# CONFIG_HWMON is not set
# CONFIG_VGA_CONSOLE is not set
#
#USB support
#
# CONFIG_HID_SUPPORT is not set

CONFIG_USB_SUPPORT=y
CONFIG_USB=y
CONFIG_USB_EHCI_HCD=y
CONFIG_USB_EHCI_EXYNOS=y
CONFIG_USB_GADGET=y
CONFIG_USB_S3C_HSOTG=y
#
# file systems
#
CONFIG_EXT2_FS=y
CONFIG_EXT3_FS=y
CONFIG_EXT4_FS=y
CONFIG_AUTOFS4_FS=y

#
#Graphics support
#
CONFIG_FB=y
CONFIG_LOGO=y
CONFIG_FB_S3C=y
CONFIG_BACKLIGHT_LCD_SUPPORT=y
CONFIG_LCD_CLASS_DEVICE=y
CONFIG_LCD_PLATFORM=y
CONFIG_FRAMEBUFFER_CONSOLE=y

#
#Real Time Clock
#
CONFIG_RTC_CLASS=y
CONFIG_RTC_DRV_S3C=y

CONFIG_INOTIFY=y
CONFIG_MSDOS_FS=y
CONFIG_VFAT_FS=y
CONFIG_TMPFS=y
CONFIG_TMPFS_POSIX_ACL=y
CONFIG_CRAMFS=y
CONFIG_ROMFS_FS=y
CONFIG_PARTITION_ADVANCED=y
CONFIG_BSD_DISKLABEL=y
CONFIG_SOLARIS_X86_PARTITION=y
CONFIG_NLS_CODEPAGE_437=y
CONFIG_NLS_ASCII=y
CONFIG_NLS_ISO8859_1=y
CONFIG_MAGIC_SYSRQ=y
CONFIG_DEBUG_KERNEL=y
# CONFIG_DEBUG_PREEMPT is not set
CONFIG_DEBUG_RT_MUTEXES=y
CONFIG_DEBUG_SPINLOCK=y
CONFIG_DEBUG_MUTEXES=y
CONFIG_DEBUG_SPINLOCK_SLEEP=y
CONFIG_DEBUG_INFO=y
# CONFIG_RCU_CPU_STALL_DETECTOR is not set
CONFIG_SYSCTL_SYSCALL_CHECK=y
CONFIG_DEBUG_USER=y
CONFIG_DEBUG_ERRORS=y
CONFIG_DEBUG_LL=y
CONFIG_EARLY_PRINTK=y
CONFIG_PRINTK_TIME=y
CONFIG_DEBUG_S3C_UART=1
CONFIG_CRC_CCITT=y
#
## devfs
#
CONFIG_DEVTMPFS=y
CONFIG_DEVTMPFS_MOUNT=y
```
